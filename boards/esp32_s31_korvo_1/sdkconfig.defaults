## boards/m5stack_tab5/Kconfig
```kconfig
menu "M5Stack Tab5"

config GBX_TAB5_X3_LAYOUT
    bool "UI layout with a 3x game window"
    default n
    select GBX_DISPLAY_LOCK_GAME_DRAW
    help
        The asset pack is built from assets/ui/m5stack_tab5_x3, whose
        720x480 game window is as wide as the screen and shows GBA frames
        at 3x. Without it the pack takes assets/ui/m5stack_tab5, with a
        480x320 window at 2x. See docs/ui-layouts/index.md.

        With this layout the DSI panel underran, and the picture flashed,
        so the present task holds the LVGL lock while it draws a game
        frame, see GBX_DISPLAY_LOCK_GAME_DRAW.

endmenu
```

## components/app/Kconfig
```kconfig
menu "GBX app"

config GBX_LIBRARY_ENTRIES
    int "ROM library: files and folders"
    range 256 4096
    default 4096
    help
        The entries of the ROM list, files and folders under roms/, in
        PSRAM; a card with more stops the scan there. A board with little
        PSRAM sets less in boards/<board>/sdkconfig.defaults.

config GBX_LIBRARY_NAMES_KB
    int "ROM library: pool of names, KiB"
    range 32 512
    default 512
    help
        The names of the ROM list's entries, in PSRAM; a card whose names
        take more stops the scan there. A board with little PSRAM sets less
        in boards/<board>/sdkconfig.defaults.

endmenu
```

## components/core/Kconfig
```kconfig
menu "GBX systems"

choice GBX_SYSTEMS
    prompt "Systems in the firmware"
    default GBX_SYSTEMS_ALL
    help
        The systems the firmware and the test firmware run. A chip whose
        internal RAM holds the execution core of only one of them builds
        that one alone; the shared sdkconfig.defaults.<target> file makes
        the choice. The PC build has both.

config GBX_SYSTEMS_ALL
    bool "GB, GBC and GBA"

config GBX_SYSTEMS_GB_ONLY
    bool "GB and GBC only"
    help
        The GBA's core and JIT are not built. The GB's execution core
        takes their place in internal RAM, see tools/link_core_layout.py.

config GBX_SYSTEMS_GBA_ONLY
    bool "GBA only"
    help
        The menus list and load GBA games only, and the JIT's block in
        internal RAM is sized for the GBA's JIT alone. The GB's core stays
        in the build, in flash, which the app, the GBA's worker queues and
        the test firmware share.

endchoice

endmenu

menu "GBX internal RAM budget"

config GBX_GB_JIT_POOL_KB
    int "GB JIT: code pool in internal RAM, KiB"
    range 32 192
    default 192
    help
        The GB JIT's code pool, one contiguous block of internal RAM with
        16 KiB of shared code before it, set aside when the app starts. A
        board whose internal RAM cannot spare it all sets less in
        boards/<board>/sdkconfig.defaults; blocks the pool evicts run from
        the second level in PSRAM.

endmenu

menu "GBX PSRAM budgets"

config GBX_GB_JIT_STORE_KB
    int "GB JIT: second level of the code cache, KiB"
    range 256 16384
    default 8192
    help
        The copies of the GB JIT's ROM blocks that run from PSRAM after the
        code pool evicts them, one record per 256 bytes. Each board sets it
        for its PSRAM in boards/<board>/sdkconfig.defaults. With
        GBX_GB_JIT_STORE_LEAVE_KB, a game's second level takes at most this
        much; the test firmware takes it whole.

config GBX_GB_JIT_STORE_LEAVE_KB
    int "GB JIT: PSRAM the second level leaves free, KiB"
    range 0 4096
    default 0
    help
        With 0, the GB JIT's second level takes GBX_GB_JIT_STORE_KB when
        the JIT starts. Otherwise the game sets it up once the save and the
        instant saves have their memory: it takes the PSRAM left, up to
        GBX_GB_JIT_STORE_KB, less this much, which stays free for what the
        menus and the saves allocate while the game runs. A board whose
        PSRAM a large game fills sets it in
        boards/<board>/sdkconfig.defaults.

config GBX_GBA_ROM_CACHE_KB
    int "GBA: ROM cache, KiB"
    range 1024 32768
    default 14336
    help
        A GBA ROM up to this size stays whole in PSRAM, a larger one is
        paged in. It takes one contiguous block. Each board sets it for its
        PSRAM in boards/<board>/sdkconfig.defaults.

endmenu
```

## components/platform/Kconfig
```kconfig
menu "GBX display"

config GBX_DISPLAY_ACCEL
    bool "Use the PPA / DMA2D presentation backend"
    depends on SOC_PPA_SUPPORTED && SOC_DMA2D_SUPPORTED
    default n
    help
        Select one presentation implementation at build time. The CPU
        implementation is not linked when this is enabled. The shared
        sdkconfig.defaults.<target> file supplies each SoC's display policy.
        LVGL's draw unit is configured separately with LV_USE_PPA.

config GBX_DISPLAY_LOCK_GAME_DRAW
    bool "Keep LVGL from drawing while a game frame is drawn"
    default n
    help
        The present task holds the LVGL lock while it draws a game frame,
        as it does while it copies the UI. An RGB panel's DMA reads the
        frame buffer from PSRAM while the panel scans out; on the
        ESP32-S31 it underran, and the picture shifted, when LVGL drew
        while the PPA drew a game frame. LVGL's changes then show after
        the frame.

config GBX_DISPLAY_GAME_HALF_RATE
    bool "Show every other game frame"
    default n
    help
        The present task takes a new game frame only 25 ms after the last
        one it took, which leaves every other frame of a game running at
        normal speed out; the emulator does not draw those. On the
        ESP32-C5, which has one core and quad PSRAM, presenting every frame
        of a GB game on its SPI panel took the time the emulation needed to
        keep up.

config GBX_LVGL_PPA_MIN_PIXELS
    int "Minimum clipped area for the LVGL PPA draw unit"
    depends on LV_USE_PPA
    range 0 16777216
    default 4096
    help
        Smaller draws stay with LVGL's software renderer. This includes
        neither the game scaling choice nor the presentation backend.
        Zero permits all operations supported by the pinned LVGL backend.

endmenu

menu "GBX JIT"

config GBX_JIT_CODE_PSRAM
    bool "Run all generated code from PSRAM"
    depends on IDF_TARGET_ESP32P4 && SPIRAM
    default n
    help
        Allocate the JIT code pool and its shared code in PSRAM instead of
        internal RAM, so that every generated block runs from PSRAM through
        the caches. The internal RAM this frees can hold a larger L2 cache
        (CACHE_L2_CACHE_SIZE).

endmenu

menu "GBX input"

config GBX_USB_GAMEPAD
    bool "Read a HID gamepad on the USB host port"
    depends on SOC_USB_OTG_SUPPORTED
    default n
    help
        A HID gamepad on the board's USB host port presses the keys of
        platform::keys::read(), see src/esp/usb_gamepad.cpp. The USB Host
        Library is in the build only with this option. A board turns it on
        in boards/<board>/sdkconfig.defaults once a gamepad has worked on
        its port: not every board's port gives a gamepad 5 V.

endmenu
```

## components/ui/Kconfig
```kconfig
menu "GBX UI"

config GBX_UI_STATIC_SHELL
    bool "Draw the shell once"
    default n
    help
        The game page draws the on-screen controls once, as they look
        unpressed, and does not show presses; only the speed switch follows
        its position. It shows no VFD readings either, so the board's layout
        has no VFD cells. The shared sdkconfig.defaults.<target> file of a
        chip with one core enables it, where each redraw takes time from
        the emulation.

config GBX_UI_PACK_IN_FLASH
    bool "Draw the VFD from the asset pack in flash"
    default n
    help
        The game page's VFD reads its font atlases and the shell under its
        cells where they lie in the asset pack, in flash, instead of copies
        in PSRAM. The copies take about 640 KB on an 800x480 layout; without
        them each redraw of a reading reads flash. A board whose PSRAM is
        short enables it in boards/<board>/sdkconfig.defaults.

endmenu
```
